#include "soc.dtsi"
#include "android.dtsi"
#include "spi.dtsi"
#include "pinctrl.dtsi"
#include "cpu.dtsi"
#include "sdhc.dtsi"
#include "audio.dtsi"
#include "display.dtsi"
#include "regulator.dtsi"
