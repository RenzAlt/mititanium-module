#include "panel/dsi-panel-truly-hd720-video.dtsi"
#include "panel/dsi-panel-auo-hd720-video.dtsi"
#include "panel/dsi-panel-shenchao-ili9881c-hd720-video.dtsi"
#include "panel/dsi-panel-td4310-fhdplus-video_e7.dtsi"
#include "panel/dsi-panel-td4310-fhdplus-video_e7_g55.dtsi"
#include "panel/dsi-panel-td4310-ebbg-fhdplus-video_e7.dtsi"
#include "panel/dsi-panel-nt36672-tianma-fhdplus-video_e7.dtsi"
#include "panel/dsi-panel-nt36672-csot-fhdplus-video_e7.dtsi"

&mdss_mdp {
	qcom,mdss-pref-prim-intf = "dsi";
};

&mdss_dsi {
	hw-config = "single_dsi";
};

&mdss_dsi0 {
	lab-supply = <&lab_regulator>;
	ibb-supply = <&ibb_regulator>;
	pinctrl-names = "mdss_default", "mdss_sleep";
	pinctrl-0 = <&mdss_dsi_active &mdss_te_active>;
	pinctrl-1 = <&mdss_dsi_suspend &mdss_te_suspend>;
	qcom,platform-te-gpio = <&tlmm 24 0>;
	qcom,platform-reset-gpio = <&tlmm 61 0>;
};

&mdss_dsi1 {
	status = "disabled";
};