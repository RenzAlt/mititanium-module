#include "pinctrl.dtsi"
#include "android.dtsi"
#include "audio.dtsi" 
#include "vince-qrd.dtsi" 
#include "display.dtsi" 
#include "fingerprint.dtsi" 
#include "power.dtsi" 
#include "touchscreen.dtsi" 
#include "camera.dtsi" 
#include "battery.dtsi" 
#include "regulator.dtsi" 